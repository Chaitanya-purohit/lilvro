## firmware/box3/main/Kconfig.projbuild
```kconfig
menu "Desk Buddy configuration"

config DESK_BUDDY_WIFI_SSID
    string "Wi-Fi SSID"
    default "S"
    help
        Name of the Wi-Fi network for the Desk Buddy station connection.

config DESK_BUDDY_WIFI_PASSWORD
    string "Wi-Fi password"
    default ""
    help
        Password for the configured Wi-Fi network. This value is intentionally
        empty by default and must be set with `idf.py menuconfig` when required.

config DESK_BUDDY_BACKEND_HOST
    string "Desk Buddy backend host or IP address"
    default ""
    help
        IP address or DNS name of the Mac running box3_audio_server.py. Leave
        this empty to retain microphone-level testing without audio streaming.

config DESK_BUDDY_BACKEND_PORT
    int "Desk Buddy backend TCP port"
    default 8787
    range 1 65535
    help
        TCP port used by box3_audio_server.py.

endmenu
```

## firmware/box3/sdkconfig.defaults
```kconfig
CONFIG_ESPTOOLPY_FLASHSIZE_2MB=y
CONFIG_ESPTOOLPY_FLASHSIZE="2MB"
CONFIG_PARTITION_TABLE_SINGLE_APP_LARGE=y
CONFIG_PARTITION_TABLE_FILENAME="partitions_singleapp_large.csv"
CONFIG_PARTITION_TABLE_OFFSET=0x8000
CONFIG_PARTITION_TABLE_MD5=y
```
